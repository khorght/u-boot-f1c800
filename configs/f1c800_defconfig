## configs/f1c800_defconfig
```kconfig
CONFIG_ARM=y
CONFIG_ARCH_SUNXI=y
CONFIG_MACH_SUNIV=y
CONFIG_GEN_SUN3IW2P=y
CONFIG_DRAM_CLK=408
CONFIG_DRAM_ZQ=3881979
# CONFIG_VIDEO_SUNXI is not set
CONFIG_DEFAULT_DEVICE_TREE="suniv-f1c800"
CONFIG_SPL=y
# CONFIG_SPL_DM_SERIAL is not set
CONFIG_CONS_INDEX=1
CONFIG_UART_PB=1

CONFIG_USE_BOOTARGS=y
CONFIG_BOOTARGS="console=ttyS0,115200 panic=5 rootwait root=/dev/mmcblk0p2 earlyprintk rw"
CONFIG_USE_BOOTCOMMAND=y
CONFIG_BOOTCOMMAND="load mmc 0:1 0x80008000 zImage;load mmc 0:1 0x80c08000 devicetree.dtb;bootz 0x80008000-0x80c08000;"
```
